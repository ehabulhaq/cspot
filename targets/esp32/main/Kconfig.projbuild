## targets/esp32/main/Kconfig.projbuild
```kconfig
menu "Example Configuration"

choice DEVICE_TYPE
    bool "Configure the device type"
    default DEVICE_TYPE_NODE
    help
        Configure the device type

config DEVICE_TYPE_ROOT
   bool "Root device"
config DEVICE_TYPE_NODE
   bool "Non-Root device"
   config DEVICE_TYPE_LEAF
    bool "Leaf device"
endchoice

config DEVICE_TYPE
    int
    default 1 if DEVICE_TYPE_ROOT
    default 2 if DEVICE_TYPE_NODE
    default 3 if DEVICE_TYPE_LEAF

config MESH_ID
    string "Mesh ID"
        default "123456"
        help
            The maximum length is 6 bytes. Mesh network identification,
            Nodes with the same mesh ID can, communicate with each other.

config MESH_CHANNEL
    int "Mesh network channel"
    range 1 14
    default 13
    help
        Mesh network channel.

config WIFI_SSID
    string "WiFi SSID"
    default "myssid"
    help
        SSID (network name) for the example to connect to.

config WIFI_PASSWORD
    string "WiFi Password"
    default "mypassword"
    help
        WiFi password (WPA or WPA2) for the example to use.

        Can be left blank if the network has no security set.

endmenu
```
